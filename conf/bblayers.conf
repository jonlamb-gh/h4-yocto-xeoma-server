## conf/bblayers.conf
```bitbake
# POKY_BBLAYERS_CONF_VERSION is increased each time build/conf/bblayers.conf
# changes incompatibly
POKY_BBLAYERS_CONF_VERSION = "2"

BBPATH = "${TOPDIR}"
BBFILES ?= ""

BBLAYERS ?= " \
  /home/jon/repos/personal/h4-yocto-xeoma-server/poky/meta \
  /home/jon/repos/personal/h4-yocto-xeoma-server/poky/meta-poky \
  /home/jon/repos/personal/h4-yocto-xeoma-server/poky/meta-yocto-bsp \
  /home/jon/repos/personal/h4-yocto-xeoma-server/meta-odroid \
  /home/jon/repos/personal/h4-yocto-xeoma-server/meta-openembedded/meta-oe \
  /home/jon/repos/personal/h4-yocto-xeoma-server/meta-openembedded/meta-python \
  /home/jon/repos/personal/h4-yocto-xeoma-server/meta-openembedded/meta-networking \
  "
```

## meta-h4server/conf/layer.conf
```bitbake
# We have a conf and classes directory, add to BBPATH
BBPATH .= ":${LAYERDIR}"

# We have recipes-* directories, add to BBFILES
BBFILES += "${LAYERDIR}/recipes-*/*/*.bb \
        ${LAYERDIR}/recipes-*/*/*.bbappend"

BBFILE_COLLECTIONS += "h4server"
BBFILE_PATTERN_h4server := "^${LAYERDIR}/"
BBFILE_PRIORITY_h4server = "5"

LAYERDEPENDS_h4server = "odroid-layer"

LAYERSERIES_COMPAT_h4server = "kirkstone"
```

## meta-h4server/recipes-h4server/wic/image-installer.wks
```
# create an installer disk image
# populate content to install using IMAGE_BOOT_FILES

part /boot --source bootimg-efi --sourceparams="loader=grub-efi,title=install,label=install-efi,initrd=core-image-minimal-initramfs-odroid-h4.ext4" --ondisk sda --label install --active --align 1024 --use-uuid

part / --source bootimg-partition --ondisk sda --fstype=ext4 --label image --use-uuid --align 1024

bootloader --ptable gpt --timeout=5 --append=" root=/dev/ram0 rw rootwait console=ttyS0,115200 ramdisk_size=81920 raid=noautodetect "
```
